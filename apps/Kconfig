## apps/cal/Kconfig
```kconfig
#
# For a description of the syntax of this configuration file,
# see the file kconfig-language.txt in the NuttX tools repository.
#

config XXCAR_CAL
	tristate "cal: sensor calibration session for the host GUI"
	default n
	depends on UORB && SENSORS
	select XXCAR_PARAM
	select XXCAR_SERIAL
	select XXCAR_UORB_MSGS
	select XXCAR_LOGGER
	---help---
		Serves the calibration GUI over the USB CDC port: enumerates the
		sensors it can offer and streams the selected one.

		Commands are ASCII lines, sample data is binary frames, and the
		two are told apart by the first byte ('{' or 0xA5).

		Run 'cal session' from the shell on TELEM1/DEBUG - not from a
		shell on USB, which would race it for input.

if XXCAR_CAL

config XXCAR_CAL_PROGNAME
	string "Program name"
	default "cal"

config XXCAR_CAL_PRIORITY
	int "cal task priority"
	default 100

config XXCAR_CAL_STACKSIZE
	int "cal stack size"
	default 4096

endif
```

## apps/companion/Kconfig
```kconfig
#
# For a description of the syntax of this configuration file,
# see the file kconfig-language.txt in the NuttX tools repository.
#

config XXCAR_COMPANION
	tristate "companion: companion computer link"
	default n
	depends on UORB
	select XXCAR_PARAM
	select XXCAR_SERIAL
	select XXCAR_UORB_MSGS
	---help---
		Owns the serial port whose SER_*_FUNC is 6 and routes framed
		packets to uORB topics by message id, publishing external_pose.
		The estimator pose is sent back at EXT_TX_RATE Hz.

		The router knows nothing about navigation: adding a message is a
		row in the routing table plus a topic, not a new code path.

if XXCAR_COMPANION

config XXCAR_COMPANION_PROGNAME
	string "Program name"
	default "companion"

config XXCAR_COMPANION_PRIORITY
	int "command priority"
	default 100

config XXCAR_COMPANION_STACKSIZE
	int "command stack size"
	default 2560

endif
```

## apps/control_router/Kconfig
```kconfig
config XXCAR_CONTROL_ROUTER

	tristate "control_router: RC/manual and autonomous safety router"
	default n
	depends on UORB && XXCAR_VESC
	select XXCAR_PARAM
	select XXCAR_RC_IN
	select XXCAR_UORB_MSGS
	---help---
		Selects between RC and control_cmd, owns VESC arming, and publishes
		the single actuator_command stream consumed by the VESC daemon.

if XXCAR_CONTROL_ROUTER

config XXCAR_CONTROL_ROUTER_PROGNAME
	string "Program name"
	default "control_router"

config XXCAR_CONTROL_ROUTER_PRIORITY
	int "command priority"
	default 100

config XXCAR_CONTROL_ROUTER_STACKSIZE
	int "command stack size"
	default 2048

endif
```

## apps/diag/Kconfig
```kconfig
config XXCAR_DIAG
	bool "diag: passive peripheral health and progress tests"
	default n
	depends on XXCAR_RC && XXCAR_VESC && SENSORS
```

## apps/init/Kconfig
```kconfig
#
# For a description of the syntax of this configuration file,
# see the file kconfig-language.txt in the NuttX tools repository.
#

config XXCAR_INIT
	tristate "xxcar_init: the init task (replaces nsh_main)"
	default n
	depends on NSH_CONSOLE
	---help---
		The CONFIG_INIT_ENTRYPOINT task.

		It exists so that the console's shell is a decision rather than a given.
		nsh_main unconditionally takes /dev/console and runs a shell on it, which
		made TELEM1's shell impossible to turn off - assign TELEM1 to MAVLink and
		you got MAVLink and a shell fighting over the same UART.

		Here, the console shell runs only if the console's port is set to NSH
		(SER_TEL1_FUNC). Everything on every other port is already started by the
		serial manager during board bring-up.

		Set CONFIG_INIT_ENTRYPOINT="xxcar_init_main" to use it.

if XXCAR_INIT

config XXCAR_INIT_PROGNAME
	string "Program name"
	default "xxcar_init"

config XXCAR_INIT_PRIORITY
	int "init task priority"
	default 100

config XXCAR_INIT_STACKSIZE
	int "init task stack size"
	default 4096
	---help---
		This task becomes the console shell, so it needs an NSH-sized stack.
		`ps` measures NSH using ~2136 bytes; 2048 overflowed and reset the board.

endif
```

## apps/logger/Kconfig
```kconfig
#
# For a description of the syntax of this configuration file,
# see the file kconfig-language.txt in the NuttX tools repository.
#

config XXCAR_LOGGER
	tristate "log: on-request ULog logger"
	default n
	depends on UORB && SENSORS
	select XXCAR_PARAM
	select XXCAR_RC_IN
	select XXCAR_UORB_MSGS
	---help---
		Records the uORB topics chosen by LOG_IMU / LOG_MAG / LOG_BARO / LOG_RC
		to a ULog file on the microSD, at their native rate (LOG_RATE=0) or
		capped to LOG_RATE Hz.

		ULog rather than CSV so native-rate IMU (2 kHz per IMU) is practical:
		each sample is its raw record plus a 3-byte header, not a line of
		formatted floats. Files open in pyulog / PlotJuggler / FlightPlot.

		On request only: 'log start' / 'log stop', or LOG_ENABLE=1 to start at
		boot.

if XXCAR_LOGGER

config XXCAR_LOGGER_PROGNAME
	string "Program name"
	default "log"

config XXCAR_LOGGER_PRIORITY
	int "log (command) task priority"
	default 100

config XXCAR_LOGGER_STACKSIZE
	int "log (command) stack size"
	default 2048

endif
```

## apps/mavlink/Kconfig
```kconfig
#
# For a description of the syntax of this configuration file,
# see the file kconfig-language.txt in the NuttX tools repository.
#

config XXCAR_MAVLINK
	tristate "mav: MAVLink on a serial port"
	default n
	depends on SERIAL_TERMIOS && UORB
	select XXCAR_PARAM
	select XXCAR_SERIAL
	select XXCAR_UORB_MSGS
	---help---
		MAVLink on whichever serial port has SER_*_FUNC = MAVLink.

		Uses the official generated c_library_v2 codec (deps/mavlink), so every
		message decodes - not just the ones acted on. Today it routes the
		MTF-02's OPTICAL_FLOW_RAD and DISTANCE_SENSOR to uORB, runs the PARAM
		protocol so a GCS can read/write parameters, and sends a 1 Hz HEARTBEAT.
		A new MAVLink sensor is one more switch case, not a new wire format.

if XXCAR_MAVLINK

config XXCAR_MAVLINK_PROGNAME
	string "Program name"
	default "mav"

config XXCAR_MAVLINK_PRIORITY
	int "mav task priority"
	default 100

config XXCAR_MAVLINK_STACKSIZE
	int "mav (command) stack size"
	default 2048

endif
```

## apps/pps/Kconfig
```kconfig
config XXCAR_PPS
	tristate "pps: companion pulse-per-second capture"
	default n
	depends on SENSORS && SPI
	select XXCAR_PARAM
	---help---
		Captures a 3.3 V PPS rising edge from the Jetson on TELEM2 CTS
		(PC9/TIM3_CH4). Provides lock, holdover, reacquisition and edge
		quality diagnostics without changing the monotonic system clock.

if XXCAR_PPS

config XXCAR_PPS_PROGNAME
	string "Program name"
	default "pps"

config XXCAR_PPS_PRIORITY
	int "command priority"
	default 100

config XXCAR_PPS_STACKSIZE
	int "command stack size"
	default 2048

endif
```

## apps/px4io/Kconfig
```kconfig
#
# For a description of the syntax of this configuration file,
# see the file kconfig-language.txt in the NuttX tools repository.
#

config XXCAR_PX4IO
	tristate "px4io: PX4IO co-processor client (RC input + PWM output)"
	default n
	depends on STM32H7_USART6 && SERIAL_TERMIOS
	select XXCAR_RC_IN
	---help---
		Client for the PX4IO co-processor (STM32F103) on the Pixhawk 6C,
		over USART6 (/dev/ttyS4) at 1.5 Mbaud.

		The 6C's RC IN connector and its 8 PWM servo rails belong to the IO
		chip, not to the FMU - talking to IO is the only way to reach them.
		IO demodulates SBUS/DSM/PPM itself and hands over decoded channels,
		so no protocol autodetection is needed for that connector.

		Not every FMUv6C is fitted with the IO chip; the client probes for it
		and fails cleanly when it is absent.

if XXCAR_PX4IO

config XXCAR_PX4IO_PROGNAME
	string "Program name"
	default "px4io"

config XXCAR_PX4IO_PRIORITY
	int "px4io task priority"
	default 100

config XXCAR_PX4IO_STACKSIZE
	int "px4io stack size"
	default 2048

endif
```

## apps/rc/Kconfig
```kconfig
#
# For a description of the syntax of this configuration file,
# see the file kconfig-language.txt in the NuttX tools repository.
#

config XXCAR_RC
	tristate "rc: RC receiver (SBUS / CRSF / Matek R6 PPM)"
	default n
	depends on SERIAL_TERMIOS && STM32H7_USART_INVERT
	select XXCAR_RC_IN
	select XXCAR_SERIAL
	---help---
		Decodes an RC receiver wired to a plain FMU serial port (TELEM/GPS),
		as opposed to the RC IN connector - which belongs to the PX4IO
		co-processor and is handled by XXCAR_PX4IO.

		SBUS (100000 8E2, inverted) and CRSF/ELRS (420000 8N1) are supported,
		with autodetection between them. Both backends use the same `rc_in`
		uORB topic, but assigning an FMU port to RC makes this driver the sole
		publisher and leaves PX4IO RC diagnostic-only.

		Requires STM32H7_USART_INVERT: SBUS is an inverted signal and there is
		no inverter on the FMU's serial connectors, so the STM32's own RXINV
		has to do it.

		On Pixhawk, PX4IO decodes PPM from the RC IN connector. On Matek,
		RC_PROT=3 remuxes R6/PC7 to TIM3_CH2 and captures PPM directly.

if XXCAR_RC

config XXCAR_RC_PROGNAME
	string "Program name"
	default "rc"

config XXCAR_RC_PRIORITY
	int "rc task priority"
	default 100

config XXCAR_RC_STACKSIZE
	int "rc stack size"
	default 3072

endif
```

## apps/sd_status/Kconfig
```kconfig
config XXCAR_SD_STATUS
	tristate "sd_status: live SDMMC and IDMA diagnostics"
	default n
	depends on MMCSD && STM32H7_SDMMC2
	---help---
		Report the live SDMMC2 clock/bus configuration, block geometry and
		low-overhead transfer/error counters without modifying the data path.

if XXCAR_SD_STATUS

config XXCAR_SD_STATUS_PROGNAME
	string "Program name"
	default "sd_status"

config XXCAR_SD_STATUS_PRIORITY
	int "Task priority"
	default 100

config XXCAR_SD_STATUS_STACKSIZE
	int "Stack size"
	default 2048

endif
```

## apps/sensor_status/Kconfig
```kconfig
#
# For a description of the syntax of this configuration file,
# see the file kconfig-language.txt in the NuttX tools repository.
#

config XXCAR_SENSOR_STATUS
	tristate "sensor_status: per-sensor rate + live reading"
	default n
	depends on UORB && SENSORS
	---help---
		One line per onboard sensor: whether it is streaming, the measured
		rate (Hz), and its current reading.

		Answers "what rate is each sensor at?" without the uorb_listener
		trade-off - listener prints nothing with CONFIG_DEBUG_UORB off and a
		flood of every field with it on. Rate here is measured from the topic
		generation counter, so it needs neither.

if XXCAR_SENSOR_STATUS

config XXCAR_SENSOR_STATUS_PROGNAME
	string "Program name"
	default "sensor_status"

config XXCAR_SENSOR_STATUS_PRIORITY
	int "task priority"
	default 100

config XXCAR_SENSOR_STATUS_STACKSIZE
	int "stack size"
	default 3072

endif
```

## apps/sensors/Kconfig
```kconfig
#
# For a description of the syntax of this configuration file,
# see the file kconfig-language.txt in the NuttX tools repository.
#

config XXCAR_SENSORS
	tristate "sensors: corrected, body-frame IMU"
	default n
	depends on UORB && SENSORS
	select XXCAR_PARAM
	select XXCAR_UORB_MSGS
	---help---
		Applies the stored IMU calibration and rotates the result into the
		vehicle's frame, publishing vehicle_acceleration and
		vehicle_angular_velocity.

		The raw sensor_accel / sensor_gyro topics are NOT modified. They are
		what the logger records, and keeping them raw is what allows a
		calibration to be re-derived from a recording, or checked against one
		taken before it. Correcting inside the driver would be simpler and
		would destroy the raw data at the only point it still exists.

		Which IMU feeds the corrected topics is SENS_IMU_SEL. Orientation is
		SENS_IMU0_ROT / SENS_IMU1_ROT (sensor relative to the board) composed
		with SENS_BOARD_ROT (board relative to the vehicle), numbered as PX4's
		enum Rotation.

		SENS_ACC_LPF and SENS_GYR_LPF configure native-rate second-order
		Butterworth filters on the corrected/controller topics. A fixed gyro
		notch is available through SENS_GYR_NF_FRQ and SENS_GYR_NF_BW and is
		disabled by default. Raw IMU topics and the future EKF delta path are
		unchanged.

if XXCAR_SENSORS

config XXCAR_SENSORS_PROGNAME
	string "Program name"
	default "sensors"

config XXCAR_SENSORS_PRIORITY
	int "sensors (command) task priority"
	default 100

config XXCAR_SENSORS_STACKSIZE
	int "sensors (command) stack size"
	default 2048

endif
```

## apps/serial/Kconfig
```kconfig
#
# For a description of the syntax of this configuration file,
# see the file kconfig-language.txt in the NuttX tools repository.
#

config XXCAR_SERIAL
	tristate "ser: serial port manager"
	default n
	depends on SERIAL_TERMIOS && NSH_CONSOLE
	select XXCAR_PARAM
	---help---
		Decides what runs on each FMU serial connector from parameters rather
		than from the build: function (NSH / MAVLink / GPS / RC / off) and baud
		rate, per port, editable in params.txt from a Linux host.

		NSH is not special - it is one function among several, and it can be
		moved off TELEM1 onto any other port, or run on several at once. A shell
		is always guaranteed to exist, so a bad parameter file cannot lock you
		out of the board.

		The RC IN connector and the PWM rails are NOT here: on the 6C they belong
		to the PX4IO co-processor. See XXCAR_PX4IO.

if XXCAR_SERIAL

config XXCAR_SERIAL_PROGNAME
	string "Program name"
	default "ser"

config XXCAR_SERIAL_PRIORITY
	int "ser task priority"
	default 100

config XXCAR_SERIAL_STACKSIZE
	int "ser stack size"
	default 2048

endif
```
